## components/hardware_driver/Kconfig.projbuild
```kconfig
menu "Audio Media HAL"

choice AUDIO_BOARD
    prompt "Audio hardware board"
    default ESP_LYRAT_MINI_V1_1_BOARD
    help
        Select an audio board to use with the ESP-ADF

config ESP_LYRAT_MINI_V1_1_BOARD
    bool "ESP32-Lyrat Mini V1.1"
config ESP32_KORVO_V1_1_BOARD
    bool "ESP32-Korvo V1.1"
config ESP32_S2_KALUGA_1_V1_2_BOARD
    bool "ESP32-S2-Kaluga-1 v1.2"
config ESP32_S3_BOX_BOARD
    bool "ESP32-S3-Box"
config ESP32_S3_KORVO_V4_0_BOARD
    bool "ESP32-S3-Korvo V4.0"
config ESP32_S3_KORVO2_V3_BOARD
    bool "ESP32-S3-Korvo-2 V3.0"
endchoice

choice MIC_ARRAY_TYPE
    prompt "Mic-array type"
    depends on ESP32_KORVO_V1_1_BOARD || ESP32_S3_KORVO_V1_0_BOARD || ESP_KORVO_MIX_A_V1_0_BOARD || ESP32_S3_KORVO_V2_0_BOARD || ESP_KORVO_MIX_B_V2_0_BOARD || ESP32_S3_KORVO_V3_0_BOARD

config 2_MIC_LINEAR_ARRAY
	bool "2-mic linear array"
config 3_MIC_CIRCULAR_ARRAY
	bool "3-mic circular array"
endchoice

endmenu
```

## components/hardware_driver/Kconfig.projbuild.new
```kconfig
menu "Audio Media HAL"

    choice AUDIO_BOARD
        prompt "Audio hardware board"
        default ESP32_S3_KORVO_1_V4_0_BOARD
        help
            Select an audio board to use

        config ESP32_KORVO_V1_1_BOARD
            bool "ESP32-Korvo"
            depends on IDF_TARGET_ESP32
        config ESP32_S3_BOX_BOARD
            bool "ESP32-S3-Box"
            depends on IDF_TARGET_ESP32S3
        config ESP32_S3_BOX_3_BOARD
            bool "ESP32-S3-Box-3"
            depends on IDF_TARGET_ESP32S3
        config ESP32_S3_KORVO_1_V4_0_BOARD
            bool "ESP32-S3-Korvo-1"
            depends on IDF_TARGET_ESP32S3
        config ESP32_S3_KORVO_2_V3_0_BOARD
            bool "ESP32-S3-Korvo-2"
            depends on IDF_TARGET_ESP32S3
        config ESP32_S3_EYE_BOARD
            bool "ESP32-S3-EYE"
            depends on IDF_TARGET_ESP32S3
    endchoice

endmenu
```

## components/hardware_driver/MediaHal/Kconfig.projbuild
```kconfig
menu "Audio Media HAL"

choice AUDIO_BOARD
    prompt "Audio hardware board"
    default ESP_LYRAT_MINI_V1_1_BOARD
    help
        Select an audio board to use with the ESP-ADF

config ESP_LYRAT_V4_3_BOARD
    bool "ESP32-Lyrat V4.3"
config ESP_LYRAT_V4_2_BOARD
    bool "ESP32-Lyrat V4.2"
config ESP_LYRAT_MINI_V1_0_BOARD
    bool "ESP32-Lyrat Mini V1.0"
config ESP_LYRAT_MINI_V1_1_BOARD
    bool "ESP32-Lyrat Mini V1.1"
config ESP_LYRATD_MSC_V2_1_BOARD
    bool "ESP32-LyraTD-MSC V2.1"
config ESP_LYRATD_MSC_V2_2_BOARD
    bool "ESP32-LyraTD-MSC V2.2"
config ESP_LYRATD_MSC_BV1_0_BOARD
    bool "ESP32-LyraTD-MSC BV1.0"
config ESP_LYRATD_FT_V1_0_BOARD
    bool "ESP32-LyraTD-FT V3.0"
config ESP_LYRATD_FT_DOSS_V1_0_BOARD
    bool "ESP32-LyraTD-FT DOSS V1.0"
config ESP_LYRATD_KN_V1_0_BOARD
    bool "ESP32-LyraTD-KN V1.0"
endchoice

choice AUDIO_CODEC_CHIP
    prompt "Audio codec chip"
    default CODEC_CHIP_IS_ES8311
    help
        Select an audio codec to use with the project

config CODEC_CHIP_IS_ES8388
    bool "CODEC IS ES8388"
    depends on ESP_LYRAT_V4_3_BOARD || ESP_LYRAT_V4_2_BOARD
config CODEC_CHIP_IS_ES7149
    bool "CODEC IS ES7149"
    depends on ESP_LYRATD_FT_V1_0_BOARD || ESP_LYRATD_FT_DOSS_V1_0_BOARD
config CODEC_CHIP_IS_ES8311
    bool "CODEC IS ES8311"
    depends on ESP_LYRAT_MINI_V1_1_BOARD || ESP_LYRAT_MINI_V1_0_BOARD
config CODEC_CHIP_IS_MICROSEMI
    bool "DAC IS MICROSEMI"
    depends on ESP_LYRATD_MSC_V2_1_BOARD || ESP_LYRATD_MSC_V2_2_BOARD || ESP_LYRATD_MSC_BV1_0_BOARD
config CODEC_CHIP_IS_ES8374
    bool "CODEC IS ES8374"
endchoice

choice USE_ES7243
    prompt "use external adc"
    default USE_ES7243
    help 
        choose whether use es7243

config USE_ES7243
    bool "use es7243"
    depends on ESP_LYRAT_MINI_V1_0_BOARD || ESP_LYRAT_MINI_V1_1_BOARD
config DISABLE_ES7243
    bool "disable es7243"
    depends on ESP_LYRAT_MINI_V1_0_BOARD || ESP_LYRAT_MINI_V1_1_BOARD
endchoice

choice AUDIO_DSP_CHIP
    prompt "Audio DSP chip"
    default DSP_CHIP_IS_NONE
    help
        Select an audio board dsp to use with the project
config DSP_CHIP_IS_NONE
    bool "No DSP chip"
config DSP_CHIP_IS_IM501
    bool "DSP IS IM501"
    depends on ESP_LYRATD_FT_V1_0_BOARD || ESP_LYRATD_FT_DOSS_V1_0_BOARD
config DSP_CHIP_IS_MICROSEMI
    bool "DSP IS MICROSEMI"
    depends on ESP_LYRATD_MSC_V2_1_BOARD || ESP_LYRATD_MSC_V2_2_BOARD || ESP_LYRATD_MSC_BV1_0_BOARD
endchoice

endmenu
```

## examples/chinese_tts/sdkconfig.defaults.esp32
```kconfig
CONFIG_IDF_TARGET="esp32"
CONFIG_IDF_TARGET_ESP32=y
CONFIG_ESPTOOLPY_FLASHMODE_QIO=y
CONFIG_ESPTOOLPY_FLASHFREQ_80M=y
CONFIG_ESPTOOLPY_FLASHSIZE_16MB=y
CONFIG_PARTITION_TABLE_CUSTOM=y
CONFIG_PARTITION_TABLE_CUSTOM_FILENAME="partitions.csv"
CONFIG_PARTITION_TABLE_FILENAME="partitions.csv"
CONFIG_PARTITION_TABLE_OFFSET=0x8000
CONFIG_ESP32_DEFAULT_CPU_FREQ_240=y
CONFIG_ESP32_SPIRAM_SUPPORT=y
CONFIG_SPIRAM_SPEED_80M=y
CONFIG_ESP_SYSTEM_PANIC_PRINT_REBOOT=y
```

## examples/cn_speech_commands_recognition/sdkconfig.defaults.esp32s3
```kconfig
CONFIG_IDF_TARGET="esp32s3"
CONFIG_IDF_TARGET_ESP32S3=y
CONFIG_ESPTOOLPY_FLASHMODE_QIO=y
CONFIG_ESPTOOLPY_FLASHSIZE_16MB=y
CONFIG_PARTITION_TABLE_CUSTOM=y
CONFIG_PARTITION_TABLE_CUSTOM_FILENAME="partitions.csv"
CONFIG_PARTITION_TABLE_FILENAME="partitions.csv"
CONFIG_PARTITION_TABLE_OFFSET=0x8000
CONFIG_ESP32S3_DEFAULT_CPU_FREQ_240=y
CONFIG_ESP32S3_INSTRUCTION_CACHE_32KB=y
CONFIG_ESP32S3_DATA_CACHE_64KB=y
CONFIG_ESP32S3_DATA_CACHE_LINE_64B=y
CONFIG_ESP32S3_SPIRAM_SUPPORT=y
CONFIG_SPIRAM_MODE_OCT=y
CONFIG_SPIRAM_SPEED_80M=y
# CONFIG_ESP_SYSTEM_PANIC_PRINT_HALT is not set
CONFIG_ESP_SYSTEM_PANIC_PRINT_REBOOT=y
# CONFIG_ESP_SYSTEM_PANIC_SILENT_REBOOT is not set
# CONFIG_ESP_SYSTEM_PANIC_GDBSTUB is not set
# CONFIG_ESP_SYSTEM_GDBSTUB_RUNTIME is not set
CONFIG_ESP_SYSTEM_RTC_FAST_MEM_AS_HEAP_DEPCHECK=y
CONFIG_ESP_SYSTEM_ALLOW_RTC_FAST_MEM_AS_HEAP=y

CONFIG_MODEL_IN_SPIFFS=y
# CONFIG_MODEL_IN_SDCARD is not set
CONFIG_USE_WAKENET=y
CONFIG_SR_WN_WN9_HILEXIN=y
CONFIG_USE_MULTINET=y
CONFIG_SR_MN_CHINESE=y
CONFIG_SR_MN_CN_MULTINET6_QUANT=y
CONFIG_CN_SPEECH_COMMAND_ID0="da kai kong tiao"
CONFIG_CN_SPEECH_COMMAND_ID1="guan bi kong tiao"
CONFIG_CN_SPEECH_COMMAND_ID2="zeng da feng su"
CONFIG_CN_SPEECH_COMMAND_ID3="jian xiao feng su"
CONFIG_CN_SPEECH_COMMAND_ID4="sheng gao yi du"
CONFIG_CN_SPEECH_COMMAND_ID5="jiang di yi du"
CONFIG_CN_SPEECH_COMMAND_ID6="zhi re mo shi,zhi le mo shi"
CONFIG_CN_SPEECH_COMMAND_ID7="zhi leng mo shi,zhi ren mo shi,zhi len mo shi"
CONFIG_CN_SPEECH_COMMAND_ID8="jie neng mo shi"
CONFIG_CN_SPEECH_COMMAND_ID9="guan bi jie neng mo shi"
CONFIG_CN_SPEECH_COMMAND_ID10="chu shi mo shi"
CONFIG_CN_SPEECH_COMMAND_ID11="guan bi chu shi mo shi"
CONFIG_CN_SPEECH_COMMAND_ID12="shui mian mo shi"
CONFIG_CN_SPEECH_COMMAND_ID13="guan bi shui mian mo shi"
CONFIG_CN_SPEECH_COMMAND_ID14="ding shi yi xiao shi"
CONFIG_CN_SPEECH_COMMAND_ID15="ding shi liang xiao shi"
CONFIG_CN_SPEECH_COMMAND_ID16="zui da feng su,zui gao feng su"
CONFIG_CN_SPEECH_COMMAND_ID17=""
CONFIG_CN_SPEECH_COMMAND_ID18=""
CONFIG_CN_SPEECH_COMMAND_ID19=""
CONFIG_CN_SPEECH_COMMAND_ID20=""
CONFIG_CN_SPEECH_COMMAND_ID21=""
CONFIG_CN_SPEECH_COMMAND_ID22=""
CONFIG_CN_SPEECH_COMMAND_ID23=""
CONFIG_CN_SPEECH_COMMAND_ID24=""
CONFIG_CN_SPEECH_COMMAND_ID25=""
CONFIG_CN_SPEECH_COMMAND_ID26=""
CONFIG_CN_SPEECH_COMMAND_ID27=""
CONFIG_CN_SPEECH_COMMAND_ID28=""
CONFIG_CN_SPEECH_COMMAND_ID29=""
CONFIG_CN_SPEECH_COMMAND_ID30=""
```

## examples/cn_speech_commands_recognition/sdkconfig.defaults.esp32s3box
```kconfig
CONFIG_IDF_TARGET="esp32s3"
CONFIG_IDF_TARGET_ESP32S3=y
CONFIG_BOOTLOADER_COMPILER_OPTIMIZATION_PERF=y
CONFIG_BOOTLOADER_LOG_LEVEL_NONE=y
CONFIG_BOOTLOADER_SKIP_VALIDATE_ALWAYS=y
CONFIG_ESPTOOLPY_FLASHMODE_QIO=y
CONFIG_ESPTOOLPY_FLASHSIZE_16MB=y
CONFIG_PARTITION_TABLE_CUSTOM=y
CONFIG_PARTITION_TABLE_CUSTOM_FILENAME="partitions.csv"
CONFIG_PARTITION_TABLE_FILENAME="partitions.csv"
CONFIG_PARTITION_TABLE_OFFSET=0x8000
CONFIG_ESP32_S3_BOX_BOARD=y
CONFIG_ESP32S3_DEFAULT_CPU_FREQ_240=y
CONFIG_ESP32S3_INSTRUCTION_CACHE_32KB=y
CONFIG_ESP32S3_DATA_CACHE_64KB=y
CONFIG_ESP32S3_DATA_CACHE_LINE_64B=y
CONFIG_ESP32S3_SPIRAM_SUPPORT=y
CONFIG_SPIRAM_MODE_OCT=y
CONFIG_SPIRAM_SPEED_80M=y
# CONFIG_ESP_SYSTEM_PANIC_PRINT_HALT is not set
CONFIG_ESP_SYSTEM_PANIC_PRINT_REBOOT=y
# CONFIG_ESP_SYSTEM_PANIC_SILENT_REBOOT is not set
# CONFIG_ESP_SYSTEM_PANIC_GDBSTUB is not set
# CONFIG_ESP_SYSTEM_GDBSTUB_RUNTIME is not set
CONFIG_ESP_SYSTEM_RTC_FAST_MEM_AS_HEAP_DEPCHECK=y
CONFIG_ESP_SYSTEM_ALLOW_RTC_FAST_MEM_AS_HEAP=y
CONFIG_LV_FONT_FMT_TXT_LARGE=y
CONFIG_LV_USE_QRCODE=y
CONFIG_ESP32S3_DEFAULT_CPU_FREQ_240=y
CONFIG_ESP32S3_INSTRUCTION_CACHE_32KB=y
CONFIG_ESP32S3_DATA_CACHE_64KB=y
CONFIG_ESP32S3_DATA_CACHE_LINE_64B=y
CONFIG_ESP32S3_SPIRAM_SUPPORT=y
CONFIG_SPIRAM_MODE_OCT=y
CONFIG_SPIRAM_SPEED_80M=y
CONFIG_SPIRAM_MALLOC_ALWAYSINTERNAL=4096
CONFIG_SPIRAM_TRY_ALLOCATE_WIFI_LWIP=y
CONFIG_SPIRAM_MALLOC_RESERVE_INTERNAL=16384
CONFIG_HTTPD_MAX_REQ_HDR_LEN=2048
CONFIG_HTTPD_MAX_URI_LEN=2048
CONFIG_HTTPD_WS_SUPPORT=y
# CONFIG_ESP_SYSTEM_ALLOW_RTC_FAST_MEM_AS_HEAP is not set
CONFIG_ESP_MAIN_TASK_STACK_SIZE=4096
CONFIG_ESP_CONSOLE_USB_SERIAL_JTAG=y

CONFIG_MODEL_IN_SPIFFS=y
# CONFIG_MODEL_IN_SDCARD is not set
CONFIG_USE_WAKENET=y
CONFIG_SR_WN_WN9_HILEXIN=y
CONFIG_USE_MULTINET=y
CONFIG_SR_MN_CHINESE=y
CONFIG_SR_MN_CN_MULTINET4_5_SINGLE_RECOGNITION=y
CONFIG_CN_SPEECH_COMMAND_ID0="da kai kong tiao"
CONFIG_CN_SPEECH_COMMAND_ID1="guan bi kong tiao"
CONFIG_CN_SPEECH_COMMAND_ID2="zeng da feng su"
CONFIG_CN_SPEECH_COMMAND_ID3="jian xiao feng su"
CONFIG_CN_SPEECH_COMMAND_ID4="sheng gao yi du"
CONFIG_CN_SPEECH_COMMAND_ID5="jiang di yi du"
CONFIG_CN_SPEECH_COMMAND_ID6="zhi re mo shi,zhi le mo shi"
CONFIG_CN_SPEECH_COMMAND_ID7="zhi leng mo shi,zhi ren mo shi,zhi len mo shi"
CONFIG_CN_SPEECH_COMMAND_ID8="jie neng mo shi"
CONFIG_CN_SPEECH_COMMAND_ID9="guan bi jie neng mo shi"
CONFIG_CN_SPEECH_COMMAND_ID10="chu shi mo shi"
CONFIG_CN_SPEECH_COMMAND_ID11="guan bi chu shi mo shi"
CONFIG_CN_SPEECH_COMMAND_ID12="shui mian mo shi"
CONFIG_CN_SPEECH_COMMAND_ID13="guan bi shui mian mo shi"
CONFIG_CN_SPEECH_COMMAND_ID14="ding shi yi xiao shi"
CONFIG_CN_SPEECH_COMMAND_ID15="ding shi liang xiao shi"
CONFIG_CN_SPEECH_COMMAND_ID16="zui da feng su,zui gao feng su"
CONFIG_CN_SPEECH_COMMAND_ID17=""
CONFIG_CN_SPEECH_COMMAND_ID18=""
CONFIG_CN_SPEECH_COMMAND_ID19=""
CONFIG_CN_SPEECH_COMMAND_ID20=""
CONFIG_CN_SPEECH_COMMAND_ID21=""
CONFIG_CN_SPEECH_COMMAND_ID22=""
CONFIG_CN_SPEECH_COMMAND_ID23=""
CONFIG_CN_SPEECH_COMMAND_ID24=""
CONFIG_CN_SPEECH_COMMAND_ID25=""
CONFIG_CN_SPEECH_COMMAND_ID26=""
CONFIG_CN_SPEECH_COMMAND_ID27=""
CONFIG_CN_SPEECH_COMMAND_ID28=""
CONFIG_CN_SPEECH_COMMAND_ID29=""
CONFIG_CN_SPEECH_COMMAND_ID30=""
```

## examples/deep_noise_suppression/sdkconfig.defaults
```kconfig
CONFIG_PARTITION_TABLE_CUSTOM=y
CONFIG_PARTITION_TABLE_CUSTOM_FILENAME="partitions.csv"
CONFIG_PARTITION_TABLE_FILENAME="partitions.csv"
CONFIG_PARTITION_TABLE_OFFSET=0x8000
CONFIG_ESPTOOLPY_FLASHMODE_QIO=y
CONFIG_ESPTOOLPY_FLASHSIZE_16MB=y
```

## examples/en_speech_commands_recognition/sdkconfig.defaults.esp32s3
```kconfig
CONFIG_IDF_TARGET="esp32s3"
CONFIG_IDF_TARGET_ESP32S3=y
CONFIG_ESPTOOLPY_FLASHMODE_QIO=y
CONFIG_ESPTOOLPY_FLASHSIZE_16MB=y
CONFIG_PARTITION_TABLE_CUSTOM=y
CONFIG_PARTITION_TABLE_CUSTOM_FILENAME="partitions.csv"
CONFIG_PARTITION_TABLE_FILENAME="partitions.csv"
CONFIG_PARTITION_TABLE_OFFSET=0x8000
CONFIG_ESP32S3_DEFAULT_CPU_FREQ_240=y
CONFIG_ESP32S3_INSTRUCTION_CACHE_32KB=y
CONFIG_ESP32S3_DATA_CACHE_64KB=y
CONFIG_ESP32S3_DATA_CACHE_LINE_64B=y
CONFIG_ESP32S3_SPIRAM_SUPPORT=y
CONFIG_SPIRAM_MODE_OCT=y
CONFIG_SPIRAM_SPEED_80M=y
# CONFIG_ESP_SYSTEM_PANIC_PRINT_HALT is not set
CONFIG_ESP_SYSTEM_PANIC_PRINT_REBOOT=y
# CONFIG_ESP_SYSTEM_PANIC_SILENT_REBOOT is not set
# CONFIG_ESP_SYSTEM_PANIC_GDBSTUB is not set
# CONFIG_ESP_SYSTEM_GDBSTUB_RUNTIME is not set
CONFIG_ESP_SYSTEM_RTC_FAST_MEM_AS_HEAP_DEPCHECK=y
CONFIG_ESP_SYSTEM_ALLOW_RTC_FAST_MEM_AS_HEAP=y

CONFIG_MODEL_IN_SPIFFS=y
# CONFIG_MODEL_IN_SDCARD is not set
CONFIG_USE_WAKENET=y
CONFIG_SR_WN_WN9_HIESP=y
CONFIG_USE_MULTINET=y
CONFIG_SR_MN_ENGLISH=y
CONFIG_SR_MN_CN_NONE=y
CONFIG_SR_MN_EN_MULTINET5_SINGLE_RECOGNITION_QUANT8=y
CONFIG_EN_SPEECH_COMMAND_ID0="TfL Mm c qbK"
CONFIG_EN_SPEECH_COMMAND_ID1="Sgl c Sel"
CONFIG_EN_SPEECH_COMMAND_ID2="PLd NoZ paNcL"
CONFIG_EN_SPEECH_COMMAND_ID3="TkN nN Mi StNDBnKS"
CONFIG_EN_SPEECH_COMMAND_ID4="TkN eF Mi StNDBnKS"
CONFIG_EN_SPEECH_COMMAND_ID5="hicST VnLYoM"
CONFIG_EN_SPEECH_COMMAND_ID6="LbcST VnLYoM"
CONFIG_EN_SPEECH_COMMAND_ID7="gNKRmS jc VnLYoM"
CONFIG_EN_SPEECH_COMMAND_ID8="DgKRmS jc VnLYoM"
CONFIG_EN_SPEECH_COMMAND_ID9="TkN nN jc TmVm"
CONFIG_EN_SPEECH_COMMAND_ID10="TkN eF jc TmVm"
CONFIG_EN_SPEECH_COMMAND_ID11="MdK Mm c Tm"
CONFIG_EN_SPEECH_COMMAND_ID12="MdK Mm c KnFm"
CONFIG_EN_SPEECH_COMMAND_ID13="TkN nN jc LiT"
CONFIG_EN_SPEECH_COMMAND_ID14="TkN eF jc LiT"
CONFIG_EN_SPEECH_COMMAND_ID15="pdNq jc KcLk To RfD"
CONFIG_EN_SPEECH_COMMAND_ID16="pdNq jc KcLk To GRmN"
CONFIG_EN_SPEECH_COMMAND_ID17="TkN nN eL jc LiTS"
CONFIG_EN_SPEECH_COMMAND_ID18="TkN eF eL jc LiTS"
CONFIG_EN_SPEECH_COMMAND_ID19="TkN nN jc fR KcNDgscNk"
CONFIG_EN_SPEECH_COMMAND_ID20="TkN eF jc fR KcNDgscNk"
CONFIG_EN_SPEECH_COMMAND_ID21="SfT jc TfMPRcpk To SgKSTmN DgGRmZ"
CONFIG_EN_SPEECH_COMMAND_ID22="SfT jc TfMPRcpk To SfVcNTmN DgGRmZ"
CONFIG_EN_SPEECH_COMMAND_ID23="SfT jc TfMPRcpk To dTmN DgGRmZ"
CONFIG_EN_SPEECH_COMMAND_ID24="SfT jc TfMPRcpk To NiNTmN DgGRmZ"
CONFIG_EN_SPEECH_COMMAND_ID25="SfT jc TfMPRcpk To TWfNTm DgGRmZ"
CONFIG_EN_SPEECH_COMMAND_ID26="SfT jc TfMPRcpk To TWfNTm WcN DgGRmZ"
CONFIG_EN_SPEECH_COMMAND_ID27="SfT jc TfMPRcpk To TWfNTm To DgGRmZ"
CONFIG_EN_SPEECH_COMMAND_ID28="SfT jc TfMPRcpk To TWfNTm vRm DgGRmZ"
CONFIG_EN_SPEECH_COMMAND_ID29="SfT jc TfMPRcpk To TWfNTm FeR DgGRmZ"
CONFIG_EN_SPEECH_COMMAND_ID30="SfT jc TfMPRcpk To TWfNTm FiV DgGRmZ"
CONFIG_EN_SPEECH_COMMAND_ID31="SfT jc TfMPRcpk To TWfNTm SgKS DgGRmZ"
CONFIG_EN_SPEECH_COMMAND_ID32=""
CONFIG_EN_SPEECH_COMMAND_ID33=""
CONFIG_EN_SPEECH_COMMAND_ID34=""
CONFIG_EN_SPEECH_COMMAND_ID35=""
CONFIG_EN_SPEECH_COMMAND_ID36=""
CONFIG_EN_SPEECH_COMMAND_ID37=""
CONFIG_EN_SPEECH_COMMAND_ID38=""
CONFIG_EN_SPEECH_COMMAND_ID39=""
CONFIG_EN_SPEECH_COMMAND_ID40=""
CONFIG_EN_SPEECH_COMMAND_ID41=""
CONFIG_EN_SPEECH_COMMAND_ID42=""
CONFIG_EN_SPEECH_COMMAND_ID43=""
CONFIG_EN_SPEECH_COMMAND_ID44=""
CONFIG_EN_SPEECH_COMMAND_ID45=""
CONFIG_EN_SPEECH_COMMAND_ID46=""
CONFIG_EN_SPEECH_COMMAND_ID47=""
CONFIG_EN_SPEECH_COMMAND_ID48=""
CONFIG_EN_SPEECH_COMMAND_ID49=""
CONFIG_EN_SPEECH_COMMAND_ID50=""
```

## examples/usb_uac_mic_recorder/main/Kconfig.projbuild
```kconfig
menu "USB MIC Configuration"

    choice 
        prompt "Num Of Channel"
        default THREE_CHANNEL

        config ONE_CHANNEL
            bool "One Channel config"
        config TWO_CHANNEL
            bool "Two Channels config"
        config THREE_CHANNEL
            bool "THREE Channels config"
        config FOUR_CHANNEL
            bool "Four Channels config"
    endchoice


    choice 
        prompt "Mic Bit Depth"
        default BIT_DEPTH_16

        config BIT_DEPTH_16
            bool "16 bits"
        
    endchoice

    choice 
        prompt "Mic Sampling Rate"
        default SAMPLING_RATE_16K

        config SAMPLING_RATE_16K
            bool "16000 sampling rate"
        
        config SAMPLING_RATE_48K
            bool "48000 sampling rate"

    endchoice

    config TINYUSB_DEBUG_LEVEL
        int "Tinyusb debug level"
        default 0
        range 0 3
        help
           Tinyusb debug level.

endmenu
```
